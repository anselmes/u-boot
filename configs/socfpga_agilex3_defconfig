## configs/socfpga_agilex3_defconfig
```kconfig
#include <configs/socfpga_agilex5_defconfig>

CONFIG_DEFAULT_DEVICE_TREE="socfpga_agilex3_socdk"
CONFIG_IDENT_STRING="socfpga_agilex3"
CONFIG_SYS_PROMPT="SOCFPGA_AGILEX3 # "
```
