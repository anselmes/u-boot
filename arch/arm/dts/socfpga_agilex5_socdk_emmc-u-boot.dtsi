// SPDX-License-Identifier: GPL-2.0+
/*
 * U-Boot additions for Agilex5 SocDK eMMC
 *
 * Copyright (C) 2025 Altera Corporation <www.altera.com>
 */

#include "socfpga_agilex5_socdk-u-boot.dtsi"

#if !defined(CONFIG_SOCFPGA_SECURE_VAB_AUTH)
&fdt_0_blob {
	filename = "arch/arm/dts/socfpga_agilex5_socdk_emmc.dtb";
};
#endif
